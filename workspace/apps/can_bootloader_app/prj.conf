## CMakeLists.txt
```
# SPDX-License-Identifier: Apache-2.0

cmake_minimum_required(VERSION 3.20.0)

# Set board root for custom boards
list(APPEND BOARD_ROOT ${CMAKE_CURRENT_SOURCE_DIR}/../..)

# Set DTS root for custom boards
list(APPEND DTS_ROOT ${CMAKE_CURRENT_SOURCE_DIR}/../..)

# Find Zephyr package
find_package(Zephyr REQUIRED HINTS $ENV{ZEPHYR_BASE})

project(can_bootloader_app VERSION 1.0.0)

# Add application sources
target_sources(app PRIVATE
    src/main.c
)

# Add custom drivers
add_subdirectory(${CMAKE_CURRENT_SOURCE_DIR}/../../drivers ${CMAKE_BINARY_DIR}/custom_drivers)

# Add custom libs
add_subdirectory(${CMAKE_CURRENT_SOURCE_DIR}/../../libs ${CMAKE_BINARY_DIR}/custom_libs)
```

## Kconfig
```
# SPDX-License-Identifier: Apache-2.0

mainmenu "CAN Bootloader Application"

# Source custom modules
rsource "../../drivers/Kconfig"
rsource "../../libs/Kconfig"

# Source Zephyr Kconfig
source "Kconfig.zephyr"
```

## prj.conf
```kconfig
# SPDX-License-Identifier: Apache-2.0

# Kernel settings
CONFIG_MAIN_STACK_SIZE=2048
CONFIG_SYSTEM_WORKQUEUE_STACK_SIZE=2048

# Use minimal libc instead of picolibc to avoid compatibility issues
CONFIG_MINIMAL_LIBC=y

# Console and logging
CONFIG_CONSOLE=y
CONFIG_UART_CONSOLE=y
CONFIG_LOG=y
CONFIG_LOG_DEFAULT_LEVEL=3
CONFIG_PRINTK=y

# GPIO
CONFIG_GPIO=y

# CAN
CONFIG_CAN=y
CONFIG_CAN_LOG_LEVEL_INF=y

# Flash and storage
CONFIG_FLASH=y
CONFIG_FLASH_MAP=y
CONFIG_FLASH_PAGE_LAYOUT=y
CONFIG_STREAM_FLASH=y

# MCUboot support
CONFIG_BOOTLOADER_MCUBOOT=y
CONFIG_IMG_MANAGER=y
CONFIG_MCUBOOT_IMG_MANAGER=y
CONFIG_IMG_ENABLE_IMAGE_CHECK=y

# MCUboot image signing (generates unsigned image for development)
CONFIG_MCUBOOT_GENERATE_UNSIGNED_IMAGE=y

# Custom drivers and libs
CONFIG_CAN_UPDATE=y
CONFIG_UPDATE_PROTOCOL=y

# Enable watchdog
CONFIG_WATCHDOG=y

# Enable reboot functionality
CONFIG_REBOOT=y

# MPU and stack protection
CONFIG_ARM_MPU=y
CONFIG_HW_STACK_PROTECTION=y
CONFIG_THREAD_STACK_INFO=y
```

## src/main.c
```c
/*
 * SPDX-License-Identifier: Apache-2.0
 *
 * CAN Bootloader Application
 * Demonstrates MCUboot with CAN bus firmware updates
 */

#include <zephyr/kernel.h>
#include <zephyr/device.h>
#include <zephyr/drivers/gpio.h>
#include <zephyr/drivers/can.h>
#include <zephyr/dfu/mcuboot.h>
#include <zephyr/logging/log.h>
#include <zephyr/sys/reboot.h>

#include "can_update.h"

LOG_MODULE_REGISTER(main, LOG_LEVEL_INF);

/* LED0 for status indication */
#define LED0_NODE DT_ALIAS(led0)
static const struct gpio_dt_spec led = GPIO_DT_SPEC_GET(LED0_NODE, gpios);

/* CAN device - use CAN1 directly */
#if DT_NODE_HAS_STATUS(DT_NODELABEL(can1), okay)
#define CAN_DEV DEVICE_DT_GET(DT_NODELABEL(can1))
#define HAS_CAN_BUS 1
#else
#define HAS_CAN_BUS 0
#warning "No CAN bus available on this board"
#endif

/* Status LED blink thread */
#define LED_THREAD_STACK_SIZE 512
#define LED_THREAD_PRIORITY 5

static void led_blink_thread(void *arg1, void *arg2, void *arg3)
{
	ARG_UNUSED(arg1);
	ARG_UNUSED(arg2);
	ARG_UNUSED(arg3);

	while (1) {
		enum can_update_status status = can_update_get_status();

		switch (status) {
		case CAN_UPDATE_STATUS_IDLE:
			/* Slow blink - idle */
			gpio_pin_toggle_dt(&led);
			k_sleep(K_MSEC(1000));
			break;
		case CAN_UPDATE_STATUS_IN_PROGRESS:
			/* Fast blink - updating */
			gpio_pin_toggle_dt(&led);
			k_sleep(K_MSEC(100));
			break;
		case CAN_UPDATE_STATUS_SUCCESS:
			/* Solid on - success */
			gpio_pin_set_dt(&led, 1);
			k_sleep(K_MSEC(100));
			break;
		case CAN_UPDATE_STATUS_ERROR:
			/* Very fast blink - error */
			gpio_pin_toggle_dt(&led);
			k_sleep(K_MSEC(50));
			break;
		}
	}
}

K_THREAD_DEFINE(led_thread, LED_THREAD_STACK_SIZE, led_blink_thread,
                NULL, NULL, NULL, LED_THREAD_PRIORITY, 0, 0);

int main(void)
{
	int ret;

	LOG_INF("CAN Bootloader Application v1.0.0");
	LOG_INF("Built: " __DATE__ " " __TIME__);

	/* Check if we're running from MCUboot */
	if (boot_is_img_confirmed()) {
		LOG_INF("Image already confirmed");
	} else {
		LOG_INF("Confirming image...");
		ret = boot_write_img_confirmed();
		if (ret) {
			LOG_ERR("Failed to confirm image: %d", ret);
		} else {
			LOG_INF("Image confirmed successfully");
		}
	}

	/* Initialize LED */
	if (!gpio_is_ready_dt(&led)) {
		LOG_ERR("LED device not ready");
		return -1;
	}

	ret = gpio_pin_configure_dt(&led, GPIO_OUTPUT_ACTIVE);
	if (ret < 0) {
		LOG_ERR("Failed to configure LED: %d", ret);
		return -1;
	}

	/* Initialize CAN update driver */
#if HAS_CAN_BUS
	ret = can_update_init(CAN_DEV);
	if (ret) {
		LOG_ERR("Failed to initialize CAN update: %d", ret);
		return -1;
	}
	LOG_INF("System initialized, waiting for CAN updates...");
#else
	LOG_WRN("CAN bus not available, update functionality disabled");
	LOG_INF("System initialized");
#endif

	/* Monitor for update completion and reboot if needed */
#if HAS_CAN_BUS
	enum can_update_status last_status = CAN_UPDATE_STATUS_IDLE;

	while (1) {
		enum can_update_status status = can_update_get_status();

		if (status == CAN_UPDATE_STATUS_SUCCESS && last_status != status) {
			LOG_INF("Update completed, rebooting in 5 seconds...");
			k_sleep(K_SECONDS(5));
			sys_reboot(SYS_REBOOT_COLD);
		}

		last_status = status;
		k_sleep(K_MSEC(100));
	}
#else
	/* Just blink LED without CAN functionality */
	while (1) {
		k_sleep(K_SECONDS(1));
	}
#endif

	return 0;
}
```
