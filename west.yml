## west.yml
```yaml
manifest:
  version: "0.13"

  defaults:
    remote: zephyrproject

  remotes:
    - name: zephyrproject
      url-base: https://github.com/zephyrproject-rtos

  projects:
    - name: zephyr
      remote: zephyrproject
      revision: main
      import:
        # Only import essential modules for STM32F7 CAN bootloader
        name-allowlist:
          - cmsis_6      # ARM CMSIS headers
          - hal_stm32  # STM32 HAL
          - mcuboot    # Bootloader
          - mbedtls    # Crypto for MCUboot image signing
          - tinycrypt  # Alternative crypto library

  self:
    path: workspace
    west-commands: scripts/west-commands.yml
```

## workspace/Kconfig
```kconfig
# SPDX-License-Identifier: Apache-2.0

mainmenu "Custom Workspace Configuration"

rsource "drivers/Kconfig"
rsource "libs/Kconfig"

source "Kconfig.zephyr"
```

## workspace/boards/arm/stm32f7_custom/Kconfig.board
```kconfig
# SPDX-License-Identifier: Apache-2.0

config BOARD_STM32F7_CUSTOM
	bool "STM32F7 Custom Board"
	depends on SOC_STM32F767XX
```

## workspace/boards/arm/stm32f7_custom/Kconfig.defconfig
```kconfig
# SPDX-License-Identifier: Apache-2.0

if BOARD_STM32F7_CUSTOM

config BOARD
	default "stm32f7_custom"

if NETWORKING

config NET_L2_ETHERNET
	default y

endif # NETWORKING

if CAN

config CAN_INIT_PRIORITY
	default 80

endif # CAN

endif # BOARD_STM32F7_CUSTOM
```

## workspace/boards/arm/stm32f7_custom/stm32f7_custom_defconfig
```kconfig
# SPDX-License-Identifier: Apache-2.0

# Architecture
CONFIG_SOC_SERIES_STM32F7X=y
CONFIG_SOC_STM32F767XX=y

# Platform Configuration
CONFIG_BOARD_STM32F7_CUSTOM=y

# Serial Drivers
CONFIG_SERIAL=y
CONFIG_UART_INTERRUPT_DRIVEN=y

# Console
CONFIG_CONSOLE=y
CONFIG_UART_CONSOLE=y

# Pinctrl
CONFIG_PINCTRL=y

# GPIO
CONFIG_GPIO=y

# CAN
CONFIG_CAN=y

# Enable MPU
CONFIG_ARM_MPU=y

# HW Stack Protection
CONFIG_HW_STACK_PROTECTION=y
```

## workspace/drivers/Kconfig
```kconfig
# SPDX-License-Identifier: Apache-2.0

menu "Custom Drivers"

rsource "can_update/Kconfig"

endmenu
```

## workspace/drivers/can_update/Kconfig
```kconfig
# SPDX-License-Identifier: Apache-2.0

config CAN_UPDATE
	bool "CAN Bus Firmware Update Support"
	depends on CAN && FLASH && IMG_MANAGER
	help
	  Enable firmware update over CAN bus. This driver receives
	  firmware image chunks over CAN and writes them to flash
	  using the Zephyr image manager.

if CAN_UPDATE

config CAN_UPDATE_FILTER_ID
	hex "CAN filter ID for firmware updates"
	default 0x100
	help
	  CAN message ID used for firmware update data transfers.

config CAN_UPDATE_CHUNK_SIZE
	int "Maximum chunk size for CAN updates"
	default 64
	range 8 64
	help
	  Maximum size of firmware chunks sent per CAN message.

config CAN_UPDATE_TIMEOUT_MS
	int "Timeout for CAN update operations (ms)"
	default 5000
	help
	  Timeout in milliseconds for CAN update operations.

endif # CAN_UPDATE
```

## workspace/libs/Kconfig
```kconfig
# SPDX-License-Identifier: Apache-2.0

menu "Custom Libraries"

rsource "update_protocol/Kconfig"
rsource "j1939_address_claim/Kconfig"

endmenu
```

## workspace/libs/j1939_address_claim/Kconfig
```kconfig
# SPDX-License-Identifier: Apache-2.0

config J1939_ADDRESS_CLAIM
	bool "J1939 Address Claim Support"
	depends on CAN
	help
	  Enable J1939 Address Claim functionality for dynamic address
	  assignment on CAN bus networks following SAE J1939-81 specification.

if J1939_ADDRESS_CLAIM

config J1939_AC_DEFAULT_PRIORITY
	int "Default J1939 priority for Address Claim messages"
	default 6
	range 0 7
	help
	  Default priority for J1939 Address Claim messages (0-7, lower is higher priority).
	  Default is 6 per J1939 specification.

config J1939_AC_CLAIM_TIMEOUT_MS
	int "Address Claim timeout in milliseconds"
	default 250
	range 100 1000
	help
	  Time to wait after sending Address Claimed message before considering
	  the address successfully claimed. Default is 250ms per J1939-81 spec.

config J1939_AC_DEFAULT_MANUFACTURER_CODE
	int "Default manufacturer code"
	default 0
	range 0 2047
	help
	  11-bit manufacturer code (0-2047). Use 0 for unassigned/testing.
	  Contact SAE to get an official manufacturer code.

config J1939_AC_ARBITRARY_CAPABLE
	bool "Enable arbitrary address capable mode by default"
	default y
	help
	  If enabled, the device can claim any available address on the bus
	  if the preferred address is already taken. If disabled, the device
	  can only use its preferred address.

endif # J1939_ADDRESS_CLAIM
```

## workspace/libs/update_protocol/Kconfig
```kconfig
# SPDX-License-Identifier: Apache-2.0

config UPDATE_PROTOCOL
	bool "Firmware Update Protocol Library"
	help
	  Common protocol definitions and utilities for firmware updates.
	  Provides encoding/decoding functions for update messages.
```
